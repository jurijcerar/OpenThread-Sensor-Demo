## sample.yaml
```
sample:
  name: Building Automation Server
tests:
  sample.automation.server:
    tags: openthread coap led gpio
    depends_on: gpio
    harness: led
    integration_platforms:
      - nrf52840dk_nrf52840
    platform_allow: nrf52840dk_nrf52840
```

## prj.conf
```kconfig
# SPDX-License-Identifier: Apache-2.0

# L2 OpenThread enabling
CONFIG_NET_L2_OPENTHREAD=y
# Generic networking options
CONFIG_NETWORKING=y
CONFIG_NET_IPV6=y
CONFIG_NET_UDP=y
# Enable CoAP protocol
CONFIG_COAP=y
CONFIG_COAP_LOG_LEVEL_DBG=y
CONFIG_COAP_SERVER=y
CONFIG_OPENTHREAD=y
CONFIG_OPENTHREAD_COAP=y
CONFIG_OPENTHREAD_THREAD_VERSION_1_1=y

# ---------------------------------------------------------------------------
# Thread network credentials — EXAMPLE VALUES ONLY, replace before deployment
# All-zero XPANID and NetworkKey are insecure and must not be used in production
# ---------------------------------------------------------------------------
CONFIG_OPENTHREAD_MANUAL_START=n
CONFIG_OPENTHREAD_NETWORK_NAME="CHANGE_ME"
CONFIG_OPENTHREAD_PANID=0x1234
CONFIG_OPENTHREAD_XPANID="00:00:00:00:00:00:00:00"
CONFIG_OPENTHREAD_NETWORKKEY="00:00:00:00:00:00:00:00:00:00:00:00:00:00:00:00"

# Network shell
CONFIG_SHELL=y
CONFIG_OPENTHREAD_SHELL=y
CONFIG_SHELL_ARGC_MAX=26
CONFIG_SHELL_CMD_BUFF_SIZE=416

# Additional params
CONFIG_FPU=y
CONFIG_GPIO=y
CONFIG_JSON_LIBRARY=y
CONFIG_CBPRINTF_FP_SUPPORT=y
CONFIG_LOG=y

# Enable Zephyr Crypto API
CONFIG_CRYPTO=y
CONFIG_CRYPTO_INIT_PRIORITY=90

# Enable TinyCrypt for AES decryption
CONFIG_CRYPTO_TINYCRYPT_SHIM=y
CONFIG_TINYCRYPT=y
CONFIG_TINYCRYPT_AES=y
CONFIG_TINYCRYPT_SHA256=y

# Stack size
CONFIG_MAIN_STACK_SIZE=10240
```

## src/main.c
```c
#include <zephyr/kernel.h>
#include <zephyr/device.h>
#include <zephyr/drivers/gpio.h>
#include <zephyr/net/openthread.h>
#include <zephyr/sys/printk.h>
#include "led.h"
#include "button.h"
#include "coap.h"
#include "crypto.h"
#include "json.h"

#define SLEEP_TIME_MS 1000

/* Timer drives LED status updates at 1 s intervals */
K_TIMER_DEFINE(mytimer, led_timer_cb, NULL);

static void addIPv6Address(void);

void main(void)
{
    /* Configure peripherals */
    configure_leds();
    configure_buttons();

    /* Initialize CoAP before starting the timer */
    coap_init();

    /* Add a static mesh-local IPv6 address for CoAP reachability */
    addIPv6Address();

    /* Start periodic LED status timer (initial delay 10 s, period 1 s) */
    k_timer_start(&mytimer, K_SECONDS(10), K_SECONDS(1));

    /* Main loop */
    while (1) {
        k_msleep(SLEEP_TIME_MS);
    }
}

static void addIPv6Address(void)
{
    otInstance *Myinstance = openthread_get_default_instance();
    if (Myinstance == NULL) {
        printk("Failed to get OpenThread instance\n");
        return;
    }

    const otMeshLocalPrefix *ml_prefix = otThreadGetMeshLocalPrefix(Myinstance);
    if (ml_prefix == NULL) {
        printk("Failed to get Mesh Local Prefix\n");
        return;
    }

    otNetifAddress aAddress;
    uint8_t interfaceID[8] = {0x00, 0x00, 0x00, 0x00, 0x00, 0x00, 0x00, 0x01};

    memcpy(&aAddress.mAddress.mFields.m8[0], ml_prefix, 8);
    memcpy(&aAddress.mAddress.mFields.m8[8], interfaceID, 8);

    aAddress.mPrefixLength = 64;
    aAddress.mPreferred    = true;
    aAddress.mValid        = true;

    otError error = otIp6AddUnicastAddress(Myinstance, &aAddress);
    if (error != OT_ERROR_NONE) {
        printk("addIPv6Address error: %d\n", error);
    } else {
        printk("IPv6 address added successfully\n");
    }
}
```

## src/coap.c
```c
#include "coap.h"
#include "crypto.h"
#include "json.h"
#include <openthread/thread.h>
#include <openthread/coap.h>
#include <zephyr/net/openthread.h>
#include <zephyr/sys/printk.h>

/* Buffer for received (and after decryption, plaintext) data */
#define TEXTBUFFER_SIZE 256
char myText[TEXTBUFFER_SIZE];
uint16_t myText_length = 0;

/* CoAP resource definition */
static otCoapResource m_storedata_resource = {
    .mUriPath = "storedata",
    .mHandler = storedata_request_cb,
    .mContext = NULL,
    .mNext    = NULL
};

static void storedata_respond_send(otMessage *p_request_message,
                                   const otMessageInfo *p_message_info)
{
    otError error = OT_ERROR_NO_BUFS;
    otMessage *p_response;
    otInstance *p_instance = openthread_get_default_instance();

    p_response = otCoapNewMessage(p_instance, NULL);
    if (p_response == NULL) {
        printk("Failed to allocate message for CoAP response!\n");
        return;
    }

    do {
        error = otCoapMessageInitResponse(p_response, p_request_message,
                                          OT_COAP_TYPE_ACKNOWLEDGMENT,
                                          OT_COAP_CODE_CHANGED);
        if (error != OT_ERROR_NONE) {
            break;
        }

        error = otCoapSendResponse(p_instance, p_response, p_message_info);
    } while (false);

    if (error != OT_ERROR_NONE) {
        printk("Failed to send store data response: %d\n", error);
        otMessageFree(p_response);
    }
}

void storedata_request_cb(void *p_context, otMessage *p_message,
                          const otMessageInfo *p_message_info)
{
    otCoapCode messageCode = otCoapMessageGetCode(p_message);
    otCoapType messageType = otCoapMessageGetType(p_message);

    do {
        if (messageType != OT_COAP_TYPE_CONFIRMABLE &&
            messageType != OT_COAP_TYPE_NON_CONFIRMABLE) {
            break;
        }
        if (messageCode != OT_COAP_CODE_PUT) {
            break;
        }

        myText_length = otMessageRead(p_message, otMessageGetOffset(p_message),
                                      myText, TEXTBUFFER_SIZE - 1);
        myText[myText_length] = '\0';

        uint8_t decrypted_data[256];
        size_t decrypted_data_len = sizeof(decrypted_data);

        if (decrypt_data((const uint8_t *)myText, myText_length,
                         decrypted_data, &decrypted_data_len) != 0) {
            printk("Decryption failed\n");
            return;
        }

        /* Remove zero-padding added by the client before encryption */
        size_t unpadded_len = decrypted_data_len;
        while (unpadded_len > 0 && decrypted_data[unpadded_len - 1] == 0) {
            unpadded_len--;
        }
        decrypted_data[unpadded_len] = '\0';

        strncpy(myText, (char *)decrypted_data, TEXTBUFFER_SIZE - 1);
        myText[TEXTBUFFER_SIZE - 1] = '\0';

        if (messageType == OT_COAP_TYPE_CONFIRMABLE) {
            storedata_respond_send(p_message, p_message_info);
        }

        /* Submit JSON parsing work — led_status() runs from the timer,
         * which fires after the work queue has processed the new data */
        k_work_submit(&json_work);

    } while (false);
}

void coap_init(void)
{
    otError error = OT_ERROR_NONE;
    otInstance *p_instance = openthread_get_default_instance();
    m_storedata_resource.mContext = p_instance;

    do {
        error = otCoapStart(p_instance, OT_DEFAULT_COAP_PORT);
        if (error != OT_ERROR_NONE) {
            break;
        }

        otCoapAddResource(p_instance, &m_storedata_resource);
    } while (false);

    if (error != OT_ERROR_NONE) {
        printk("CoAP init error: %d\n", error);
    }
}
```

## src/coap.h
```c
#ifndef COAP_H
#define COAP_H

#include <openthread/thread.h>

// Function prototypes
void storedata_request_cb(void *p_context, otMessage *p_message, const otMessageInfo *p_message_info);
void coap_init(void);

#endif // COAP_H
```

## src/crypto.c
```c
#include "crypto.h"
#include <tinycrypt/aes.h>
#include <tinycrypt/constants.h>
#include <zephyr/sys/printk.h>

#define AES_KEY_SIZE   16
#define AES_BLOCK_SIZE 16

/* TODO: Replace with a secure key management solution before production use.
 * This key must match the one configured on the client side. */
uint8_t aes_key[AES_KEY_SIZE] = {
    0x00, 0x01, 0x02, 0x03, 0x04, 0x05, 0x06, 0x07,
    0x08, 0x09, 0x0A, 0x0B, 0x0C, 0x0D, 0x0E, 0x0F
};

int decrypt_data(const uint8_t *input, size_t input_len, uint8_t *output, size_t *output_len)
{
    struct tc_aes_key_sched_struct aes;

    if (tc_aes128_set_decrypt_key(&aes, aes_key) == TC_CRYPTO_FAIL) {
        printk("Failed to set AES decryption key!\n");
        return -1;
    }

    /* Decrypt each block with AES-ECB */
    for (size_t i = 0; i < input_len; i += AES_BLOCK_SIZE) {
        if (tc_aes_decrypt(output + i, input + i, &aes) == TC_CRYPTO_FAIL) {
            printk("AES decryption failed!\n");
            return -1;
        }
    }

    *output_len = input_len;

    return 0;
}
```

## src/crypto.h
```c
#ifndef CRYPTO_H
#define CRYPTO_H

#include <stddef.h>
#include <stdint.h>

// Function prototype
int decrypt_data(const uint8_t *input, size_t input_len, uint8_t *output, size_t *output_len);

#endif // CRYPTO_H
```

## src/led.c
```c
#include "led.h"
#include "json.h"
#include <zephyr/drivers/gpio.h>

bool led0_enabled = false;
bool led1_enabled = false;
bool led2_enabled = false;
bool led3_enabled = false;

/* LED device specs from devicetree aliases */
const struct gpio_dt_spec l0 = GPIO_DT_SPEC_GET(DT_ALIAS(led0), gpios);
const struct gpio_dt_spec l1 = GPIO_DT_SPEC_GET(DT_ALIAS(led1), gpios);
const struct gpio_dt_spec l2 = GPIO_DT_SPEC_GET(DT_ALIAS(led2), gpios);
const struct gpio_dt_spec l3 = GPIO_DT_SPEC_GET(DT_ALIAS(led3), gpios);

void configure_leds(void)
{
    gpio_pin_configure_dt(&l0, GPIO_OUTPUT);
    gpio_pin_configure_dt(&l1, GPIO_OUTPUT);
    gpio_pin_configure_dt(&l2, GPIO_OUTPUT);
    gpio_pin_configure_dt(&l3, GPIO_OUTPUT);
}

void led_status(void)
{
    if (led0_enabled) {
        if (sensor_data.temperature > TEMP_MAX || sensor_data.temperature < TEMP_MIN) {
            gpio_pin_toggle_dt(&l0);
        } else {
            gpio_pin_set_dt(&l0, 1);
        }
    }
    if (led1_enabled) {
        if (sensor_data.pressure > PRESS_MAX || sensor_data.pressure < PRESS_MIN) {
            gpio_pin_toggle_dt(&l1);
        } else {
            gpio_pin_set_dt(&l1, 1);
        }
    }
    if (led2_enabled) {
        if (sensor_data.humidity > HUM_MAX || sensor_data.humidity < HUM_MIN) {
            gpio_pin_toggle_dt(&l2);
        } else {
            gpio_pin_set_dt(&l2, 1);
        }
    }
    if (led3_enabled) {
        if (sensor_data.gas_resistance > GAS_MAX || sensor_data.gas_resistance < GAS_MIN) {
            gpio_pin_toggle_dt(&l3);
        } else {
            gpio_pin_set_dt(&l3, 1);
        }
    }
}

/* Timer callback: only drives LED status display.
 * JSON parsing is triggered from coap.c upon receiving new data,
 * ensuring led_status() always operates on already-parsed values. */
void led_timer_cb(struct k_timer *dummy)
{
    led_status();
}
```
