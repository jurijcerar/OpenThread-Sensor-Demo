## CMakeLists.txt
```
# SPDX-License-Identifier: Apache-2.0

cmake_minimum_required(VERSION 3.20.0)
find_package(Zephyr REQUIRED HINTS $ENV{ZEPHYR_BASE})
project(client)

set(SOURCE_FILES
    src/main.c
    src/sensor.c
    src/coap_client.c
    src/crypto.c
)
target_sources(app PRIVATE ${SOURCE_FILES})
```

## sample.yaml
```
sample:
  name: BME680 Sensor Sample
tests:
  sample.sensor.bme680:
    tags: sensor openthread coap
    harness: sensor
    integration_platforms:
      - nrf52840dk_nrf52840
    platform_allow: nrf52840dk_nrf52840 adafruit_feather_nrf52840
```

## prj.conf
```kconfig
# SPDX-License-Identifier: Apache-2.0

CONFIG_STDOUT_CONSOLE=y
CONFIG_I2C=y
CONFIG_SENSOR=y

# L2 OpenThread enabling
CONFIG_NET_L2_OPENTHREAD=y
# Generic networking options
CONFIG_NETWORKING=y
# Enable CoAP protocol
CONFIG_OPENTHREAD_COAP=y

# ---------------------------------------------------------------------------
# Thread network credentials — EXAMPLE VALUES ONLY, replace before deployment
# All-zero XPANID and NetworkKey are insecure and must not be used in production
# ---------------------------------------------------------------------------
CONFIG_OPENTHREAD_MANUAL_START=n
CONFIG_OPENTHREAD_NETWORK_NAME="CHANGE_ME"
CONFIG_OPENTHREAD_PANID=0x1234
CONFIG_OPENTHREAD_XPANID="00:00:00:00:00:00:00:00"
CONFIG_OPENTHREAD_NETWORKKEY="00:00:00:00:00:00:00:00:00:00:00:00:00:00:00:00"

# Network shell
CONFIG_SHELL=y
CONFIG_OPENTHREAD_SHELL=y
CONFIG_SHELL_ARGC_MAX=26
CONFIG_SHELL_CMD_BUFF_SIZE=416

# Additional params
CONFIG_FPU=y
CONFIG_GPIO=y
CONFIG_CBPRINTF_FP_SUPPORT=y

# Enable Zephyr Crypto API
CONFIG_CRYPTO=y
CONFIG_CRYPTO_INIT_PRIORITY=90

# Enable TinyCrypt for AES encryption
CONFIG_CRYPTO_TINYCRYPT_SHIM=y
CONFIG_TINYCRYPT=y
CONFIG_TINYCRYPT_AES=y
CONFIG_TINYCRYPT_SHA256=y

# Buffer and stack sizes
CONFIG_NET_BUF_RX_COUNT=10
CONFIG_NET_BUF_TX_COUNT=10
CONFIG_NET_PKT_RX_COUNT=10
CONFIG_NET_PKT_TX_COUNT=10

CONFIG_OPENTHREAD_MESSAGE_BUFFER_SIZE=1024

CONFIG_MAIN_STACK_SIZE=4096
CONFIG_SYSTEM_WORKQUEUE_STACK_SIZE=2048
```

## src/main.c
```c
#include <zephyr/kernel.h>
#include "sensor.h"
#include "coap_client.h"

/* Timer for periodic data sending */
K_TIMER_DEFINE(mytimer, send_data_timer_cb, NULL);

int main(void) {
    // Start the periodic timer
    k_timer_start(&mytimer, K_SECONDS(16), K_SECONDS(4));

    // Initialize CoAP
    coap_init();

    // Main loop
    while (1) {
        k_sleep(K_MSEC(3000));
    }

    return 0;
}
```

## src/coap_client.c
```c
#include "coap_client.h"
#include <openthread/coap.h>
#include <openthread/thread.h>
#include <zephyr/net/openthread.h>
#include <zephyr/sys/printk.h>
#include "sensor.h"
#include "crypto.h"

/* Maximum size for the JSON payload buffer.
 * Format: {"temperature": XXXX, "pressure": XXXX, "humidity": XXXX, "gas_resistance": XXXXXXX}
 * Fixed-size buffer avoids VLAs on the stack. */
#define JSON_BUFFER_SIZE  128
#define PADDED_BUFFER_SIZE 128  /* Must be >= JSON_BUFFER_SIZE, multiple of AES_BLOCK_SIZE (16) */

void coap_send_data_response_cb(void *p_context, otMessage *p_message,
                                const otMessageInfo *p_message_info, otError result)
{
    if (result == OT_ERROR_NONE) {
        printk("Delivery confirmed!\n");
    } else {
        printk("Delivery error: %d\n", result);
    }
}

void coap_send_data_request(void)
{
    otError error = OT_ERROR_NONE;
    otMessage *myMessage;
    otInstance *myInstance = openthread_get_default_instance();
    otMessageInfo myMessageInfo;

    const otMeshLocalPrefix *ml_prefix = otThreadGetMeshLocalPrefix(myInstance);
    uint8_t serverInterfaceID[8] = {0x00, 0x00, 0x00, 0x00, 0x00, 0x00, 0x00, 0x01};

    /* Build JSON payload from current sensor data */
    char mySensorDataJson[JSON_BUFFER_SIZE];
    snprintf(mySensorDataJson, sizeof(mySensorDataJson),
             "{\"temperature\": %d, \"pressure\": %d, \"humidity\": %d, \"gas_resistance\": %d}",
             sensor_data.temp.val1, sensor_data.press.val1,
             sensor_data.humidity.val1, sensor_data.gas_res.val1);

    printk("Original data: %s\n", mySensorDataJson);

    /* Pad to AES block boundary using fixed-size buffers (no VLAs) */
    size_t input_len = strlen(mySensorDataJson);
    size_t padded_len = ((input_len + AES_BLOCK_SIZE - 1) / AES_BLOCK_SIZE) * AES_BLOCK_SIZE;

    uint8_t padded_data[PADDED_BUFFER_SIZE];
    uint8_t encrypted_data[PADDED_BUFFER_SIZE];

    memset(padded_data, 0, sizeof(padded_data));
    memcpy(padded_data, mySensorDataJson, input_len); /* Zero-pad the remainder */

    /* Encrypt the padded data */
    if (encrypt_data(padded_data, padded_len, encrypted_data) != 0) {
        printk("Encryption failed!\n");
        return;
    }

    /* Build and send CoAP PUT request */
    do {
        myMessage = otCoapNewMessage(myInstance, NULL);
        if (myMessage == NULL) {
            printk("Failed to allocate message for CoAP request!\n");
            return;
        }

        otCoapMessageInit(myMessage, OT_COAP_TYPE_CONFIRMABLE, OT_COAP_CODE_PUT);

        error = otCoapMessageAppendUriPathOptions(myMessage, "storedata");
        if (error != OT_ERROR_NONE) {
            break;
        }

        error = otCoapMessageAppendContentFormatOption(myMessage,
                                                       OT_COAP_OPTION_CONTENT_FORMAT_JSON);
        if (error != OT_ERROR_NONE) {
            break;
        }

        error = otCoapMessageSetPayloadMarker(myMessage);
        if (error != OT_ERROR_NONE) {
            break;
        }

        error = otMessageAppend(myMessage, encrypted_data, padded_len);
        if (error != OT_ERROR_NONE) {
            break;
        }

        memset(&myMessageInfo, 0, sizeof(myMessageInfo));
        memcpy(&myMessageInfo.mPeerAddr.mFields.m8[0], ml_prefix, 8);
        memcpy(&myMessageInfo.mPeerAddr.mFields.m8[8], serverInterfaceID, 8);
        myMessageInfo.mPeerPort = OT_DEFAULT_COAP_PORT;

        error = otCoapSendRequest(myInstance, myMessage, &myMessageInfo,
                                  coap_send_data_response_cb, NULL);
    } while (false);

    if (error == OT_ERROR_NONE) {
        printk("CoAP data sent\n");
    } else {
        printk("CoAP data send error: %d\n", error);
        otMessageFree(myMessage);
    }
}

void coap_init(void)
{
    otInstance *p_instance = openthread_get_default_instance();
    otError error = otCoapStart(p_instance, OT_DEFAULT_COAP_PORT);
    if (error != OT_ERROR_NONE) {
        printk("CoAP init error: %d\n", error);
    }
}

/* Timer callback: submit sensor work first; CoAP send is triggered from
 * sensor_work_cb once fresh data is available (see sensor.c). */
void send_data_timer_cb(struct k_timer *dummy)
{
    k_work_submit(&sensor_work);
}
```

## src/coap_client.h
```c
#ifndef COAP_CLIENT_H
#define COAP_CLIENT_H

#include <zephyr/kernel.h>
#include <openthread/message.h>
#include <openthread/ip6.h>

// Function prototypes
void coap_send_data_request(void);
void coap_send_data_response_cb(void *p_context, otMessage *p_message, const otMessageInfo *p_message_info, otError result);
void coap_init(void);
void send_data_timer_cb(struct k_timer *dummy);

#endif // COAP_CLIENT_H
```

## src/crypto.c
```c
#include "crypto.h"
#include <tinycrypt/aes.h>
#include <tinycrypt/constants.h>
#include <zephyr/sys/printk.h>

#define AES_KEY_SIZE 16
#define AES_BLOCK_SIZE 16

/* TODO: Replace with a secure key management solution before production use.
 * This key must match the one configured on the server side. */
uint8_t aes_key[AES_KEY_SIZE] = {
    0x00, 0x01, 0x02, 0x03, 0x04, 0x05, 0x06, 0x07,
    0x08, 0x09, 0x0A, 0x0B, 0x0C, 0x0D, 0x0E, 0x0F
};

int encrypt_data(const uint8_t *input, size_t input_len, uint8_t *output) {
    struct tc_aes_key_sched_struct aes;

    if (tc_aes128_set_encrypt_key(&aes, aes_key) == TC_CRYPTO_FAIL) {
        printk("Failed to set AES encryption key!\n");
        return -1;
    }

    for (size_t i = 0; i < input_len; i += AES_BLOCK_SIZE) {
        if (tc_aes_encrypt(output + i, input + i, &aes) == TC_CRYPTO_FAIL) {
            printk("AES encryption failed!\n");
            return -1;
        }
    }

    return 0;
}
```

## src/crypto.h
```c
#ifndef CRYPTO_H
#define CRYPTO_H

#include <stddef.h>
#include <stdint.h>

#define AES_BLOCK_SIZE 16

// Extern declaration of AES key
extern uint8_t aes_key[16];

// Function prototype
int encrypt_data(const uint8_t *input, size_t input_len, uint8_t *output);

#endif // CRYPTO_H
```

## src/sensor.c
```c
#include "sensor.h"
#include "coap_client.h"
#include <zephyr/drivers/sensor.h>
#include <zephyr/sys/printk.h>

struct SensorData sensor_data;

void sensor_work_cb(struct k_work *work)
{
    const struct device *const dev = DEVICE_DT_GET_ONE(bosch_bme680);

    if (!device_is_ready(dev)) {
        printk("sensor: device not ready.\n");
        return;
    }

    sensor_sample_fetch(dev);
    sensor_channel_get(dev, SENSOR_CHAN_AMBIENT_TEMP, &sensor_data.temp);
    sensor_channel_get(dev, SENSOR_CHAN_PRESS,         &sensor_data.press);
    sensor_channel_get(dev, SENSOR_CHAN_HUMIDITY,      &sensor_data.humidity);
    sensor_channel_get(dev, SENSOR_CHAN_GAS_RES,       &sensor_data.gas_res);

    /* Send data immediately after collection so CoAP always uses fresh values */
    coap_send_data_request();
}

K_WORK_DEFINE(sensor_work, sensor_work_cb);
```

## src/sensor.h
```c
#ifndef SENSOR_H
#define SENSOR_H

#include <zephyr/kernel.h>
#include <zephyr/drivers/sensor.h>

// Structure to hold sensor data
struct SensorData {
    struct sensor_value temp;
    struct sensor_value press;
    struct sensor_value humidity;
    struct sensor_value gas_res;
};

// Function prototypes
void sensor_work_cb(struct k_work *work);

// External variables
extern struct k_work sensor_work;
extern struct SensorData sensor_data;

#endif // SENSOR_H
```
